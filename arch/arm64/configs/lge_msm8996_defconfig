## arch/arm64/configs/lge_msm8996_defconfig
```kconfig
include msm-perf_defconfig
# LG Platform
CONFIG_MACH_LGE=y

# ARM
CONFIG_NR_CPUS=4
CONFIG_CPUSETS=y
CONFIG_PROC_PID_CPUSET=y

# CPU
CONFIG_RCU_KTHREAD_PRIO=1
CONFIG_RCU_BOOST=y
CONFIG_MSM_APM=y
CONFIG_MSM_IDLE_STATS=y
CONFIG_MSM_IDLE_STATS_FIRST_BUCKET=62500
CONFIG_MSM_IDLE_STATS_BUCKET_SHIFT=2
CONFIG_MSM_IDLE_STATS_BUCKET_COUNT=10
CONFIG_MSM_SUSPEND_STATS_FIRST_BUCKET=1000000000
CONFIG_WQ_POWER_EFFICIENT_DEFAULT=y

# Broadcom - Bluetooth
CONFIG_BT_BCM43XX=y
CONFIG_BT_MSM_SLEEP=y

# Fingerprint Cards
CONFIG_INPUT_FINGERPRINT=y
CONFIG_INPUT_FINGERPRINT_FPC1020=y

# NXP
# CONFIG_NFC is not set
CONFIG_LGE_NFC=y
# CONFIG_NFC_BCM2079X is not set
CONFIG_LGE_NFC_PN547_C2=y
# CONFIG_LGE_NFC_PRESTANDBY is not set
# CONFIG_LGE_NFC_MULTICORE_FASTBOOT is not set
CONFIG_LGE_NFC_SET_IRQ_WAKEUP=y
# CONFIG_LGE_NFC_DEBUG_MESSAGE is not set
# CONFIG_LGE_NFC_USE_PMIC is not set
# CONFIG_NFC_NQ is not set
# CONFIG_CXD224X_NFC is not set

# Other
CONFIG_PSTORE=y
CONFIG_PSTORE_CONSOLE=y
CONFIG_PSTORE_PMSG=y
CONFIG_PSTORE_RAM=y
CONFIG_IOSCHED_BFQ=y
CONFIG_CGROUP_BFQIO=y
CONFIG_LGE_HANDLE_PANIC=y
CONFIG_LGE_HALL_IC=y
CONFIG_ZRAM_LZ4_COMPRESS=y
CONFIG_SERIAL_MSM_HSL=y
CONFIG_SERIAL_MSM_HSL_CONSOLE=y
CONFIG_EXT4_FS_ENCRYPTION=y
CONFIG_VM_MAX_READAHEAD=2048
#
#
# DOS/FAT/NT Filesystems
#
# CONFIG_MSDOS_FS is not set
# CONFIG_EXFAT_FS is not set
# CONFIG_NTFS_FS is not set
CONFIG_VFAT_FS=y
CONFIG_SDFAT_FS=y
CONFIG_SDFAT_USE_FOR_EXFAT=y
CONFIG_SDFAT_USE_FOR_VFAT=n
CONFIG_SDFAT_DELAYED_META_DIRTY=y
CONFIG_SDFAT_SUPPORT_DIR_SYNC=y
CONFIG_SDFAT_DEFAULT_CODEPAGE=437
CONFIG_SDFAT_DEFAULT_IOCHARSET="utf8"
CONFIG_SDFAT_CHECK_RO_ATTR=y
CONFIG_SDFAT_ALIGNED_MPAGE_WRITE=y
CONFIG_SDFAT_VIRTUAL_XATTR=y
CONFIG_SDFAT_VIRTUAL_XATTR_SELINUX_LABEL="u:object_r:sdcard_external:s0"
CONFIG_SDFAT_SUPPORT_STLOG=y
# CONFIG_SDFAT_DEBUG is not set
CONFIG_SDFAT_STATISTICS=y

# Treble
CONFIG_CP15_BARRIER_EMULATION=y
CONFIG_SETEND_EMULATION=y
CONFIG_SECURITY_PERF_EVENTS_RESTRICT=y

# Vibrator
CONFIG_QPNP_HAPTIC=y

# Disable QCOM drivers to avoid confliction
CONFIG_BT_RFCOMM=n
CONFIG_MSM_BT_POWER=n
CONFIG_NFC_NQ=n
CONFIG_CNSS=n
CONFIG_USELIB=n

# exFAT support
CONFIG_SDCARD_FS=y
CONFIG_FAT_DEFAULT_IOCHARSET="utf8"

# Adreno Idler
CONFIG_ADRENO_IDLER=y

# Other tweaks
CONFIG_HZ_300=y
CONFIG_HZ=300
CONFIG_ARM64_CPUIDLE=y
CONFIG_ARCH_NEEDS_CPU_IDLE_COUPLED=y
CONFIG_TCP_CONG_WESTWOOD=y
CONFIG_IOSCHED_MAPLE=y
CONFIG_DEFAULT_TCP_CONG="westwood"
CONFIG_DEFAULT_WESTWOOD=y
CONFIG_THERMAL_WRITABLE_TRIPS=y
CONFIG_LGE_QFPROM_INTERFACE=y
CONFIG_TRUSTONIC_TEE=y
CONFIG_CMA_PINPAGE_MIGRATION=y

# Boeffla WL Blocker
CONFIG_BOEFFLA_WL_BLOCKER=y

# Cpu Input boost
CONFIG_CPU_INPUT_BOOST=y
CONFIG_INPUT_BOOST_DURATION_MS=64
CONFIG_INPUT_BOOST_FREQ_LP=825600
CONFIG_INPUT_BOOST_FREQ_PERF=422400
```

## arch/arm64/configs/lineageos_h870_defconfig
```kconfig
include lineageos_lucye_common
# LG Platform
CONFIG_MACH_MSM8996_LUCYE_GLOBAL_COM=y

# Broadcom - Wifi
CONFIG_BCMDHD=y
CONFIG_BCMDHD_LEGACY=y
CONFIG_BCMDHD_PCIE=y
CONFIG_BCM43455=y
CONFIG_BCMDHD_COB=y
CONFIG_BCMDHD_USE_SCHED_SCAN=y
CONFIG_BCMDHD_FOLLOW_AP_DTIM_PERIOD=n
CONFIG_WIFI_CONTROL_FUNC=y
# exFAT Support
CONFIG_EXFAT_FS=y
CONFIG_EXFAT_DISCARD=y
CONFIG_EXFAT_DELAYED_SYNC=y
# sdFAT Support
CONFIG_SDCARD_FS=y                      
CONFIG_VFAT_FS=y                        
CONFIG_FAT_DEFAULT_IOCHARSET="utf8"    
CONFIG_SDFAT_SUPPORT_DIR_SYNC=y         
CONFIG_SDFAT_CHECK_RO_ATTR=y 

# Adreno Idler
CONFIG_ADRENO_IDLER=y

CONFIG_HZ_1000=y
CONFIG_ARM64_CPUIDLE=y
CONFIG_ARCH_NEEDS_CPU_IDLE_COUPLED=y
```

## drivers/net/can/spi/Kconfig
```kconfig
menu "CAN SPI interfaces"
	depends on SPI

config CAN_MCP251X
	tristate "Microchip MCP251x SPI CAN controllers"
	depends on HAS_DMA
	---help---
	  Driver for the Microchip MCP251x SPI CAN controllers.

config CAN_K61
	tristate "Freescale K61 SPI CAN controllers"
	depends on SPI
	---help---
	  Driver for the Freescale K61 SPI CAN controllers.
endmenu
```

## drivers/usb/lge/Kconfig
```kconfig
config LGE_USB_G_ANDROID
	boolean "LGE Android Gadget for LG PC host Driver"
	depends on USB_G_ANDROID
	help
	  Customized Android Gadget USB framework for
	  LGE United PC host USB driver.

	default n

config LGE_USB_G_MULTIPLE_CONFIGURATION
        boolean "LGE Multiple Configuration"
        depends on LGE_USB_G_ANDROID
        help
          Support multiple mtp functions in multiple configuration.
          Add another descriptor for 2nd mtp function.

          Say y if this must be needed.

        default n

config LGE_USB_G_LAF
        boolean "LGE specific LAF support in LGE Android"
        depends on LGE_USB_G_ANDROID
        help
          It supports LGE specific LAF feature.

          Say y if this must be needed.

        default y

config LGE_USB_EMBEDDED_BATTERY
        boolean "power cycle when factory cable is connected"
        help
          In case of the phone with embedded battery, power cycle is implemented
          when factory cable is connected.

          Say y if this must be needed.

        default n

config LGE_USB_MAXIM_EVP
       boolean "EVP charger support"

config LGE_USB_G_ANDROID
	boolean "LGE Android Gadget for LG PC host Driver"
	depends on USB_G_ANDROID
	help
	  Customized Android Gadget USB framework for
	  LGE United PC host USB driver.

	default n

config LGE_USB_G_AUTORUN
	boolean "Common autorun support in LGE Android"
	depends on LGE_USB_G_ANDROID
	help
	  Autorun is LGE specific feature which is able to install PC host
	  USB driver automatically on Autorun-enabled OS(Ex. Windows). For this,
	  virtual-cdrom device is provided on LGE Android powered device.

	default n

config LGE_USB_G_CDROM_MAC_SUPPORT
	boolean "USB CDROM support patch of LGE Android on Mac OS-X"
	depends on LGE_USB_G_AUTORUN
	help
	  This feature is based on Roger Quadros' patch as following;

	  - usb:gadget:storage: Make CD-ROM emulation work with Mac OS-X
	  - usb:gadget:f_mass_storage: Make CD-ROM emulation work with Mac OS-X

	  ref: https://lkml.org/lkml/2011/4/5/190

	  - Here is comment of committer:

	  Mac OS-X expects CD-ROM TOC in raw format (i.e. format:2). It also
	  sends the READ_TOC CDB in old style SFF8020i format. i.e. 2 format bits
	  are encoded in MSBs of CDB byte 9.

	  The first patch introduces a fsg_get_toc() helper which builds the
	  Table of Contents (TOC) that can be used for the READ_TOC command.
	  The remaining two patches simply make file_storage gadget and mass_storage
	  gadget use the new helper function.

	  Say y if this feature must be used.

	default y

config LGE_USB_G_AUTORUN_VZW
	boolean "VZW specific autorun support in LGE Android"
	depends on LGE_USB_G_AUTORUN
	help
	  It supports VZW specific autorun feature. note that this
	  must be used in VZW devices.

	  Say y if this must be needed.

	default n

config LGE_USB_G_MULTIPLE_CONFIGURATION
	boolean "LGE Multiple Configuration"
	depends on LGE_USB_G_ANDROID
	help
	  Support multiple mtp functions in multiple configuration.
	  Add another descriptor for 2nd mtp function.

	  Say y if this must be needed.

	default n

config LGE_USB_G_NCM
	boolean "LGE specific mirror link support in LGE Android"
	depends on LGE_USB_G_ANDROID
	help
	 It supports LGE specific mirror link feature.

	 Say y if this must be needed.

	default n

config LGE_USB_G_LAF
	boolean "LGE specific LAF support in LGE Android"
	depends on LGE_USB_G_ANDROID
	help
	  It supports LGE specific LAF feature.

	  Say y if this must be needed.

	default y

config LGE_USB_FACTORY
	boolean "Force full speed support if pif is connected in LGE Android"
	depends on LGE_USB_G_ANDROID && LGE_PM
	help
	   This feature is that USB set forcely full speed if pif cable is
	   connected. It is only for PIF cable, not normal USB cable.

	   Say y if this must be needed.

	default y

config LGE_USB_DIAG_LOCK
	boolean "feature for usb diag access lock"
	depends on LGE_USB_G_ANDROID
	help
	  this feature should be applied to meet usb diag lock requirement

	  Say y if this must be needed.

	default y

config LGE_USB_DIAG_LOCK_SPR
	boolean "feature for usb diag access lock"
	depends on LGE_USB_DIAG_LOCK
	help
	  this feature should be applied to meet SPR requirement

	  Say y if this must be needed.

	default n

config LGE_USB_DIAG_LOCK_TRF
	boolean "feature for usb diag access lock"
	depends on LGE_USB_DIAG_LOCK
	help
	  this feature should be applied to meet TRF requirement

	  Say y if this must be needed.

	default n


config LGE_USB_EMBEDDED_BATTERY
	boolean "power cycle when factory cable is connected"
	help
	  In case of the phone with embedded battery, power cycle is implemented
          when factory cable is connected.

	  Say y if this must be needed.

	default n

config LGE_USB_DIAG_LOCK_VZW
	boolean "feature for usb diag access lock"
	depends on LGE_USB_DIAG_LOCK
	help
	  this feature should be applied to meet VZW requirement

	  Say y if this must be needed.

	default n

config LGE_USB_TYPE_C
	bool "USB Type-C support"
	help
	  Say Y here to add support for USB Type-C.

config LGE_USB_MAXIM_EVP
       boolean "EVP charger support"

config LGE_USB_COMPLIANCE_TEST
	bool "USB Compliance test"
	select LGE_USB_BC_12_VZW
```
